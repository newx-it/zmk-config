## config/west.yml
```yaml
manifest:
  remotes:
    - name: zmk
      url-base: https://github.com/newx-it
    - name: urob
      url-base: https://github.com/urob
    - name: newx-it
      url-base: https://github.com/newx-it
    - name: nguyendown
      url-base: https://github.com/nguyendown
  projects:
    - name: zmk
      remote: zmk
      revision: feat-ble-prevent-sleep-while-active-connected
      import: app/west.yml
    - name: zmk-auto-layer
      remote: urob
      revision: main # set to same version as zmk above
    - name: zmk-adaptive-key
      remote: urob
      revision: main # set to same as ZMK version above
    - name: zmk-unicode
      remote: urob
      revision: main
    - name: zmk-nice-oled
      remote: newx-it
      revision: main
    - name: zmk-behavior-socd
      remote: nguyendown
      revision: main
  self:
    path: config
```
